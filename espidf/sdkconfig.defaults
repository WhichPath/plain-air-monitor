## espidf/sdkconfig.defaults
```kconfig
# PM Display direct-tailnet experiment - ESP32-S3 sdkconfig defaults
# Target
CONFIG_IDF_TARGET="esp32s3"

# LilyGO T-Display-S3: ESP32-S3R8, 16MB QSPI flash, 8MB OPI PSRAM
CONFIG_ESPTOOLPY_FLASHMODE_QIO=y
CONFIG_ESPTOOLPY_FLASHFREQ_80M=y
CONFIG_ESPTOOLPY_FLASHSIZE_16MB=y
CONFIG_ESPTOOLPY_FLASHSIZE="16MB"

# PSRAM (required for large buffers)
CONFIG_SPIRAM=y
CONFIG_SPIRAM_MODE_OCT=y
CONFIG_SPIRAM_SPEED_80M=y
CONFIG_SPIRAM_TRY_ALLOCATE_WIFI_LWIP=y

# lwIP (WireGuard needs raw sockets + larger buffers)
CONFIG_LWIP_MAX_SOCKETS=16
CONFIG_LWIP_SO_RCVBUF=y
CONFIG_LWIP_TCPIP_RECVMBOX_SIZE=64
CONFIG_LWIP_TCP_SND_BUF_DEFAULT=32768
CONFIG_LWIP_TCP_WND_DEFAULT=32768

# mbedTLS (Noise protocol needs ChaCha20-Poly1305)
CONFIG_MBEDTLS_CHACHA20_C=y
CONFIG_MBEDTLS_POLY1305_C=y
CONFIG_MBEDTLS_CHACHAPOLY_C=y
CONFIG_MBEDTLS_HKDF_C=y
CONFIG_MBEDTLS_SSL_PROTO_TLS1_2=y

# FreeRTOS
CONFIG_FREERTOS_HZ=1000
CONFIG_FREERTOS_TIMER_TASK_STACK_DEPTH=4096

# WiFi - low-latency tuning for WireGuard traffic
CONFIG_ESP_WIFI_STATIC_RX_BUFFER_NUM=10
CONFIG_ESP_WIFI_DYNAMIC_RX_BUFFER_NUM=32
CONFIG_ESP_WIFI_AMPDU_TX_ENABLED=n
CONFIG_ESP_WIFI_AMPDU_RX_ENABLED=n

# CPU frequency (240MHz for crypto performance)
CONFIG_ESP_DEFAULT_CPU_FREQ_MHZ_240=y

# Watchdog (extended for TLS handshakes)
CONFIG_ESP_TASK_WDT_TIMEOUT_S=30

# Partition table. T-Display-S3 has 16MB flash; keep a larger NVS area for
# MicroLink keys/peer cache plus hourly PM aggregates.
CONFIG_PARTITION_TABLE_CUSTOM=y
CONFIG_PARTITION_TABLE_CUSTOM_FILENAME="partitions.csv"
CONFIG_PARTITION_TABLE_FILENAME="partitions.csv"

# Log level
CONFIG_LOG_DEFAULT_LEVEL_INFO=y

# Disable the upstream config UI by default.
# The current upstream implementation has no request authentication.
CONFIG_ML_ENABLE_CONFIG_HTTPD=n
CONFIG_ML_CONFIG_MAX_ALLOWED_PEERS=16

# Priority peer (guaranteed WG slot even when peer table is full)
CONFIG_ML_PRIORITY_PEER_IP=""
```
